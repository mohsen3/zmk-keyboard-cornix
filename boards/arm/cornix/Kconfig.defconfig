## boards/arm/cornix/Kconfig.defconfig
```kconfig
# Electronut Labs Papyr board configuration

# Copyright (c) 2020 The ZMK Contributors
# SPDX-License-Identifier: MIT

if BOARD_CORNIX

config BOARD
    default "cornix"

endif # BOARD_CORNIX

## Peripheral device (left side)
if BOARD_CORNIX_LEFT

config ZMK_SPLIT_ROLE_CENTRAL
    default n

config ZMK_SPLIT_BLE_ROLE_CENTRAL
	default n

# Optimized keyboard debouncing for low latency
# Reduced press from 3ms to 2ms for faster response with stability
# Release kept at 5ms for stability
config ZMK_KSCAN_DEBOUNCE_PRESS_MS
    default 2
config ZMK_KSCAN_DEBOUNCE_RELEASE_MS
    default 5

endif # BOARD_CORNIX_LEFT

## Main device (right side)
if BOARD_CORNIX_RIGHT || BOARD_CORNIX_DONGLE

config ZMK_KEYBOARD_NAME
	default "Cornix"

if USB

config USB_NRFX
    default y

config USB_DEVICE_STACK
    default y

endif # USB
config ZMK_SPLIT_ROLE_CENTRAL
    default y

config ZMK_SPLIT_BLE_ROLE_CENTRAL
	default y

config ZMK_SPLIT_BLE_CENTRAL_BATTERY_LEVEL_FETCHING
	default y

config ZMK_SPLIT_BLE_CENTRAL_BATTERY_LEVEL_PROXY
	default y

endif # BOARD_CORNIX_RIGHT

## Peripheral device config for dongle mode (left side)
if BOARD_CORNIX_PH_LEFT

config ZMK_KEYBOARD_NAME
	default "Cornix Dongle"

config ZMK_SPLIT_ROLE_CENTRAL
    default n

config ZMK_SPLIT_BLE_ROLE_CENTRAL
	default n

# Optimized keyboard debouncing for low latency
# Reduced press from 3ms to 2ms for faster response with stability
# Release kept at 5ms for stability
config ZMK_KSCAN_DEBOUNCE_PRESS_MS
    default 2
config ZMK_KSCAN_DEBOUNCE_RELEASE_MS
    default 5

endif # BOARD_CORNIX_PH_LEFT

## Peripheral device config for dongle mode (right side)
if BOARD_CORNIX_PH_RIGHT

config ZMK_KEYBOARD_NAME
	default "Cornix Dongle"

config ZMK_SPLIT_ROLE_CENTRAL
    default n

config ZMK_SPLIT_BLE_ROLE_CENTRAL
	default n

# Optimized keyboard debouncing for low latency
# Reduced press from 3ms to 2ms for faster response with stability
# Release kept at 5ms for stability
config ZMK_KSCAN_DEBOUNCE_PRESS_MS
    default 2
config ZMK_KSCAN_DEBOUNCE_RELEASE_MS
    default 5

endif # BOARD_CORNIX_PH_RIGHT

# Common options for both sides
if BOARD_CORNIX_LEFT  || BOARD_CORNIX_DONGLE || BOARD_CORNIX_PH_LEFT || BOARD_CORNIX_PH_RIGHT || BOARD_CORNIX_RIGHT


config BT_CTLR
    default BT

config BOARD_CORNIX_CHARGER
    default y

config ZMK_SPLIT
	default y

config ZMK_BLE
	default y

## disable rgb by default
config WS2812_STRIP
	default n
config ZMK_RGB_UNDERGLOW
	default n
config ZMK_RGB_UNDERGLOW_EXT_POWER
	default n

endif # BOARD_CORNIX_LEFT || BOARD_CORNIX_RIGHT


# vim: set ft=kconfig:
```

## boards/arm/cornix/cornix_left_defconfig
```kconfig
# e73 config

CONFIG_SOC_SERIES_NRF52X=y
CONFIG_SOC_NRF52840_QIAA=y

CONFIG_BOARD_CORNIX_LEFT=y

CONFIG_ADC_NRFX_SAADC=y

# Enable MPU
CONFIG_ARM_MPU=y

CONFIG_PINCTRL=y

# enable GPIO
CONFIG_GPIO=y

CONFIG_USE_DT_CODE_PARTITION=y
CONFIG_BUILD_OUTPUT_UF2=y

CONFIG_MPU_ALLOW_FLASH_WRITE=y

CONFIG_NVS=y
CONFIG_SETTINGS_NVS=y

CONFIG_FLASH=y
CONFIG_FLASH_PAGE_LAYOUT=y
CONFIG_FLASH_MAP=y

CONFIG_CLOCK_CONTROL_NRF=y
CONFIG_CLOCK_CONTROL_NRF_K32SRC_RC=y

# e73 config end

CONFIG_ZMK_USB=n
CONFIG_ZMK_BLE=y
CONFIG_ZMK_SPLIT=y

# Increase BLE transmit power to resolve latency and split communication issues
CONFIG_BT_CTLR_TX_PWR_PLUS_8=y

# Disable 2Mbps PHY for better compatibility
CONFIG_BT_CTLR_PHY_2M=n

# Optimized connection intervals for signal reliability
# Settings tuned to handle physical signal blockage (e.g., body between keyboard halves)
# Higher latency and timeout provide tolerance for brief signal interruptions
CONFIG_BT_PERIPHERAL_PREF_MIN_INT=6
CONFIG_BT_PERIPHERAL_PREF_MAX_INT=12
CONFIG_BT_PERIPHERAL_PREF_LATENCY=30
CONFIG_BT_PERIPHERAL_PREF_TIMEOUT=500

# Split-specific BLE parameters for peripheral-to-central connection
# These settings improve stability when signal is obstructed
CONFIG_ZMK_SPLIT_BLE_PREF_INT=6
CONFIG_ZMK_SPLIT_BLE_PREF_LATENCY=30
CONFIG_ZMK_SPLIT_BLE_PREF_TIMEOUT=500

# Change keyboard default display name

# Battery level report interval in seconds
CONFIG_ZMK_BATTERY_REPORT_INTERVAL=300

CONFIG_PINCTRL=y

# RGB
CONFIG_SPI=n

# enable display drivers
CONFIG_ZMK_DISPLAY=n

#BLE-passkey
CONFIG_ZMK_BLE_PASSKEY_ENTRY=n

#BLE-clean
CONFIG_ZMK_BLE_CLEAR_BONDS_ON_START=n

# Disable NKRO - causes compatibility issues with some systems
# Use standard 6KRO (6-Key Rollover) for better compatibility
CONFIG_ZMK_HID_REPORT_TYPE_NKRO=n

CONFIG_ZMK_POINTING=y

CONFIG_INPUT=y

CONFIG_EC11=y
CONFIG_EC11_TRIGGER_GLOBAL_THREAD=y

# 3 profiles for better memory efficiency
CONFIG_BT_MAX_CONN=3
CONFIG_BT_MAX_PAIRED=3

# ZMK Studio related configuration
CONFIG_ZMK_STUDIO=y
CONFIG_ZMK_STUDIO_LOCKING=n
CONFIG_ZMK_STUDIO_LOCK_ON_DISCONNECT=n

# Performance optimizations for reduced latency
# Eager debouncing for faster key press detection
CONFIG_ZMK_KSCAN_DEBOUNCE_PRESS_MS=2
CONFIG_ZMK_KSCAN_DEBOUNCE_RELEASE_MS=5

# Faster BLE queue processing
CONFIG_BT_BUF_EVT_RX_COUNT=16
CONFIG_BT_BUF_ACL_RX_SIZE=251
CONFIG_BT_BUF_ACL_TX_SIZE=251

# Optimize system work queue for faster HID processing
CONFIG_SYSTEM_WORKQUEUE_PRIORITY=-2

# Reduce USB polling interval (if USB is ever enabled)
CONFIG_USB_HID_POLL_INTERVAL_MS=1

# Enable deep sleep after 30 minutes of inactivity for power savings
CONFIG_ZMK_SLEEP=y
CONFIG_ZMK_IDLE_SLEEP_TIMEOUT=1800000
```

## boards/arm/cornix/cornix_ph_right_defconfig
```kconfig
# e73 config
CONFIG_SOC_SERIES_NRF52X=y
CONFIG_SOC_NRF52840_QIAA=y
CONFIG_BOARD_CORNIX=y
CONFIG_BOARD_CORNIX_PH_RIGHT=y

CONFIG_ADC_NRFX_SAADC=y

# Enable MPU
CONFIG_ARM_MPU=y

CONFIG_PINCTRL=y

# enable GPIO
CONFIG_GPIO=y

CONFIG_USE_DT_CODE_PARTITION=y
CONFIG_BUILD_OUTPUT_UF2=y

CONFIG_MPU_ALLOW_FLASH_WRITE=y
CONFIG_NVS=y
CONFIG_SETTINGS_NVS=y
CONFIG_FLASH=y
CONFIG_FLASH_PAGE_LAYOUT=y
CONFIG_FLASH_MAP=y
CONFIG_CLOCK_CONTROL_NRF=y
CONFIG_CLOCK_CONTROL_NRF_K32SRC_RC=y

# e73 config end

# Peripheral mode - no USB, BLE only
CONFIG_ZMK_USB=n
CONFIG_ZMK_BLE=y
CONFIG_ZMK_SPLIT=y
# Note: CENTRAL role is set to 'n' in Kconfig.defconfig

# Increase BLE transmit power for better range with dongle
CONFIG_BT_CTLR_TX_PWR_PLUS_8=y

# Disable ZMK Studio for peripherals
CONFIG_ZMK_STUDIO=n

CONFIG_INPUT=y

# RGB
CONFIG_SPI=n

CONFIG_ZMK_EXT_POWER=n

CONFIG_EC11=y
CONFIG_EC11_TRIGGER_GLOBAL_THREAD=y

# Battery level report interval in seconds
CONFIG_ZMK_BATTERY_REPORT_INTERVAL=300

# Disable deep sleep for peripheral
CONFIG_ZMK_SLEEP=n

# vim: set ft=kconfig:
```

## boards/arm/cornix/cornix_right_defconfig
```kconfig
# e73 config
CONFIG_SOC_SERIES_NRF52X=y
CONFIG_SOC_NRF52840_QIAA=y
CONFIG_BOARD_CORNIX=y
CONFIG_BOARD_CORNIX_RIGHT=y


CONFIG_ADC_NRFX_SAADC=y

# Enable MPU
CONFIG_ARM_MPU=y

CONFIG_PINCTRL=y

# enable GPIO
CONFIG_GPIO=y

CONFIG_USE_DT_CODE_PARTITION=y
CONFIG_BUILD_OUTPUT_UF2=y

CONFIG_MPU_ALLOW_FLASH_WRITE=y
CONFIG_NVS=y
CONFIG_SETTINGS_NVS=y
CONFIG_FLASH=y
CONFIG_FLASH_PAGE_LAYOUT=y
CONFIG_FLASH_MAP=y
CONFIG_CLOCK_CONTROL_NRF=y
CONFIG_CLOCK_CONTROL_NRF_K32SRC_RC=y

# e73 config end

CONFIG_ZMK_KEYBOARD_NAME="Cornix"
CONFIG_ZMK_USB=y
CONFIG_ZMK_SPLIT=y
CONFIG_ZMK_SPLIT_ROLE_CENTRAL=y

CONFIG_BT_CTLR_TX_PWR_PLUS_8=y

# Disable 2Mbps PHY for better compatibility
CONFIG_BT_CTLR_PHY_2M=n

# Optimized connection intervals for low latency
# Reduced intervals from 6-12 to 6-9 for faster response
# Reduced latency from 30 to 10 for more responsive connection
CONFIG_BT_PERIPHERAL_PREF_MIN_INT=6
CONFIG_BT_PERIPHERAL_PREF_MAX_INT=9
CONFIG_BT_PERIPHERAL_PREF_LATENCY=10
CONFIG_BT_PERIPHERAL_PREF_TIMEOUT=400

CONFIG_INPUT=y

# RGB
CONFIG_SPI=n

CONFIG_ZMK_EXT_POWER=n

CONFIG_EC11=y
CONFIG_EC11_TRIGGER_GLOBAL_THREAD=y

# Performance optimizations for reduced latency
# Eager debouncing for faster key press detection
CONFIG_ZMK_KSCAN_DEBOUNCE_PRESS_MS=1
CONFIG_ZMK_KSCAN_DEBOUNCE_RELEASE_MS=5

# Faster BLE queue processing
CONFIG_BT_BUF_EVT_RX_COUNT=16
CONFIG_BT_BUF_ACL_RX_SIZE=251
CONFIG_BT_BUF_ACL_TX_SIZE=251

# Optimize system work queue for faster HID processing
CONFIG_SYSTEM_WORKQUEUE_PRIORITY=-2

# Reduce USB polling interval for lower latency
CONFIG_USB_HID_POLL_INTERVAL_MS=1

# vim: set ft=kconfig:
```

## boards/hitsmaxft/cornix/Kconfig.cornix
```kconfig
# cornix board configuration

# Copyright (c) 2020 The ZMK Contributors
# SPDX-License-Identifier: MIT

config BOARD_CORNIX_LEFT
    select SOC_NRF52840_QIAA
    select ZMK_BOARD_COMPAT

config BOARD_CORNIX_DONGLE
    select SOC_NRF52840_QIAA
    select ZMK_BOARD_COMPAT

config BOARD_CORNIX_RIGHT
    select SOC_NRF52840_QIAA
    select ZMK_BOARD_COMPAT

config BOARD_CORNIX_PH_RIGHT
    select SOC_NRF52840_QIAA
    select ZMK_BOARD_COMPAT

#vim: set ft=kconfig:
```

## boards/hitsmaxft/cornix/Kconfig.cornix_dongle
```kconfig
# Copyright (c) 2020 The ZMK Contributors
# SPDX-License-Identifier: MIT

config BOARD_CORNIX_DONGLE
    select SOC_NRF52840_QIAA
    select ZMK_BOARD_COMPAT
```

## boards/hitsmaxft/cornix/Kconfig.cornix_left
```kconfig
# Copyright (c) 2020 The ZMK Contributors
# SPDX-License-Identifier: MIT

config BOARD_CORNIX_LEFT
    select SOC_NRF52840_QIAA
    select ZMK_BOARD_COMPAT
```

## boards/hitsmaxft/cornix/Kconfig.cornix_ph_right
```kconfig
# Copyright (c) 2020 The ZMK Contributors
# SPDX-License-Identifier: MIT

config BOARD_CORNIX_PH_RIGHT
    select SOC_NRF52840_QIAA
    select ZMK_BOARD_COMPAT
```

## boards/hitsmaxft/cornix/Kconfig.defconfig
```kconfig
# Cornix board configuration

# Copyright (c) 2020 The ZMK Contributors
# SPDX-License-Identifier: MIT

## Peripheral devices (left side and phantom right for dongle mode)
if BOARD_CORNIX_LEFT || BOARD_CORNIX_PH_RIGHT

config ZMK_SPLIT_ROLE_CENTRAL
    default n

config ZMK_SPLIT_BLE_ROLE_CENTRAL
	default n

# Optimized keyboard debouncing for low latency
# Reduced press from 3ms to 2ms for faster response with stability
# Release kept at 5ms for stability
config ZMK_KSCAN_DEBOUNCE_PRESS_MS
    default 2
config ZMK_KSCAN_DEBOUNCE_RELEASE_MS
    default 5

endif # BOARD_CORNIX_LEFT || BOARD_CORNIX_PH_RIGHT

## Main device (right side)
if BOARD_CORNIX_RIGHT || BOARD_CORNIX_DONGLE

config ZMK_KEYBOARD_NAME
	default "Cornix"

if USB

config USB_NRFX
    default y

config USB_DEVICE_STACK
    default y

endif # USB
config ZMK_SPLIT_ROLE_CENTRAL
    default y

config ZMK_SPLIT_BLE_ROLE_CENTRAL
	default y

config ZMK_SPLIT_BLE_CENTRAL_BATTERY_LEVEL_FETCHING
	default y

config ZMK_SPLIT_BLE_CENTRAL_BATTERY_LEVEL_PROXY
	default y

endif # BOARD_CORNIX_RIGHT || BOARD_CORNIX_DONGLE

# Common options for all board variants
if BOARD_CORNIX_LEFT || BOARD_CORNIX_DONGLE || BOARD_CORNIX_RIGHT || BOARD_CORNIX_PH_RIGHT


config BOARD_CORNIX_CHARGER
    default y

config ZMK_SPLIT
	default y

config ZMK_BLE
	default y

## disable rgb by default
config ZMK_RGB_UNDERGLOW
	default n
config ZMK_RGB_UNDERGLOW_EXT_POWER
	default n

endif # BOARD_CORNIX_LEFT || BOARD_CORNIX_RIGHT || BOARD_CORNIX_PH_RIGHT || BOARD_CORNIX_DONGLE


# vim: set ft=kconfig:
```

## boards/hitsmaxft/cornix/board.yml
```yaml
boards:
  - name: cornix_left
    vendor: hitsmaxft
    socs:
      - name: nrf52840
  - name: cornix_right
    vendor: hitsmaxft
    socs:
      - name: nrf52840
  - name: cornix_dongle
    vendor: hitsmaxft
    socs:
      - name: nrf52840
  - name: cornix_ph_right
    vendor: hitsmaxft
    socs:
      - name: nrf52840
```

## boards/shields/cornix_dongle_eyelash/Kconfig.defconfig
```kconfig
if SHIELD_CORNIX_DONGLE_EYELASH

if LVGL

config LV_Z_VDB_SIZE
    default 64

config LV_DPI_DEF
    default 148

config LV_Z_BITS_PER_PIXEL
    default 16

choice LV_COLOR_DEPTH
    default LV_COLOR_DEPTH_16
endchoice

endif # LVGL

endif

#vim: set ft=kconfig:
```
